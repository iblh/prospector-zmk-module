## Kconfig
```kconfig
config PROSPECTOR_PIPELINE_PROFILE
    bool "Temporary aggregate split and USB pipeline diagnostics"
    depends on LOG && BT && ZMK_SPLIT
    default n
    help
      Requires the pinned ZMK instrumentation staged by the firmware build script.
      Logs counts and maximum durations every two seconds, never typed contents.

config PROSPECTOR_PIPELINE_CADENCE
    bool "Measure pointing input and transport submission intervals"
    depends on PROSPECTOR_PIPELINE_PROFILE
    default n
    help
      Aggregate interval histograms only; does not change input/report scheduling.

config PROSPECTOR_BLE_TX_TRACE
    bool "Measure peripheral ATT allocation and local completion"
    depends on PROSPECTOR_PIPELINE_CADENCE && !ZMK_SPLIT_ROLE_CENTRAL
    default n
    help
      Pinned host ABI only. Linker wrappers time PDU allocation and ATT send;
      GATT completion callbacks use bounded static storage. No packet logging.

config PROSPECTOR_HCI_TRACE
    bool "Pinned controller HCI submission/completion diagnostic"
    depends on PROSPECTOR_BLE_TX_TRACE
    default n

config PROSPECTOR_SCAN_AB
    bool "USB-commanded 80-second central scan ABBA diagnostic"
    depends on PROSPECTOR_PIPELINE_CADENCE && ZMK_SPLIT_ROLE_CENTRAL && UART_CONSOLE
    default n

config PROSPECTOR_SPLIT_SCAN_POLICY
    bool "Connection-aware split keyboard scanning"
    depends on ZMK_SPLIT_ROLE_CENTRAL && ZMK_SPLIT_BLE
    select ZMK_LOW_PRIORITY_WORK_QUEUE
    default n
    help
      Fast discovery with no connected halves, 5ms/200ms background discovery
      with a half online, and no scanning once all slots are occupied.
      Requires the pinned ZMK central source supported by the module generator.

config PROSPECTOR_LEFT_SLOT_RECOVERY
    bool "Explicit one-time old left slot recovery image"
    depends on PROSPECTOR_SPLIT_SCAN_POLICY && PROSPECTOR_TOUCH_UI && SETTINGS && BT_SETTINGS
    default n
    help
      Maintenance only: gate split startup, preserve slot 0 and its bond,
      and remove slot 1's stored address and exact bond once. No global reset.

config PROSPECTOR_LEFT_RECOVERY_GENERATION
    int "Explicitly authorized left replacement generation"
    depends on PROSPECTOR_LEFT_SLOT_RECOVERY
    range 1 2
    default 1
    help
      Separate one-time transaction for a subsequent controller replacement.
      Generation 2 must only be flashed for the second authorized replacement.

config PROSPECTOR_LEFT_PERIPHERAL_SLOT
    int "Bonded BLE slot displayed as the left half (two-peripheral Touch UI)"
    range 0 1
    default 0
    depends on PROSPECTOR_TOUCH_UI
    help
      Bond slots follow pairing history, not physical handedness. This affects
      display order only. It never changes key positions or BLE bonding data.

config PROSPECTOR_INPUT_MODES
    bool "MAC-DV, WIN-DV and GAME input modes"
    depends on PROSPECTOR_TOUCH_UI && ZMK_SPLIT_ROLE_CENTRAL && ZMK_POINTING
    default n
    help
      Requires the dedicated touch_modes keymap (base layers 0,1,2).

config PROSPECTOR_RELEASE_TAG
    string "Touch firmware release label"
    default "DEV"
    depends on PROSPECTOR_TOUCH_UI

config PROSPECTOR_KEYMAP_LABEL
    string "Built keymap label shown on device page"
    default "QWERTY"
    depends on PROSPECTOR_TOUCH_UI

choice PROSPECTOR_STATUS_SCREEN_LAYOUT
    prompt "Status screen layout"
    default PROSPECTOR_STATUS_SCREEN_CLASSIC

config PROSPECTOR_STATUS_SCREEN_CLASSIC
    bool "Classic layout"
    help
        Standard Prospector status screen

config PROSPECTOR_STATUS_SCREEN_RADII
    bool "Radii layout"
    help
        Colorful grid layout with rounded widgets

config PROSPECTOR_STATUS_SCREEN_FIELD
    bool "Field layout"
    help
        Minimal layout with flowing typing activity visualization

config PROSPECTOR_STATUS_SCREEN_OPERATOR
    bool "Operator layout"
    help
        Technical and information dense layout

endchoice

config PROSPECTOR_ROTATE_DISPLAY_180
    bool "Rotate the display 180 degrees"
    default n

config PROSPECTOR_SHOW_MODIFIERS
    bool "Display modifier key indicators (Cmd, Opt, Ctrl, Shift)"
    default y

config PROSPECTOR_SHOW_INACTIVE_MODIFIERS
    bool "Show inactive modifier indicators (dim when not pressed)"
    default y
    depends on PROSPECTOR_SHOW_MODIFIERS
    help
      When enabled, inactive modifiers are shown with a dim color.
      When disabled, inactive modifiers are hidden completely.
      Only affects classic and field layouts.

config PROSPECTOR_MODIFIER_ORDER
    string "Modifier display order"
    default "GACS"
    depends on PROSPECTOR_SHOW_MODIFIERS
    help
      Order of modifier indicators. Use exactly 4 characters:
      G=GUI/Cmd, A=Alt/Opt, C=Control, S=Shift.
      Each character must appear exactly once.

choice PROSPECTOR_MODIFIER_OS
    prompt "Modifier key style"
    default PROSPECTOR_MODIFIER_OS_MAC
    depends on PROSPECTOR_SHOW_MODIFIERS

config PROSPECTOR_MODIFIER_OS_GENERIC
    bool "Generic (CTRL, ALT, GUI, SHFT)"

config PROSPECTOR_MODIFIER_OS_WINDOWS
    bool "Windows"

config PROSPECTOR_MODIFIER_OS_MAC
    bool "Mac"

endchoice

config PROSPECTOR_USE_AMBIENT_LIGHT_SENSOR
    bool "Use ambient light sensor for auto brightness"
    default y

rsource "drivers/sensor/apds9960/Kconfig"

config PROSPECTOR_FIXED_BRIGHTNESS
    int "Fixed display brightness"
    default 50
    range 1 100
    depends on !PROSPECTOR_USE_AMBIENT_LIGHT_SENSOR

config PROSPECTOR_BRIGHTNESS_STEP
    int "Display brightness step"
    default 10
    range 1 100
    help
      Percentage-point step used by Prospector display brightness key bindings.

config PROSPECTOR_LAYER_NAME_UPPERCASE
    bool "Display layer names in uppercase"
    default y
    help
      When enabled, layer names will be converted to uppercase for display.

config PROSPECTOR_TOUCH_UI
    bool "Enable Prospector touch settings UI"
    default n
    depends on SHIELD_PROSPECTOR_ADAPTER
    help
      Enables on-screen brightness slider with Zephyr LVGL touch input.
```
