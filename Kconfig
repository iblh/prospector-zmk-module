## Kconfig
```kconfig
config PROSPECTOR_INPUT_MODES
    bool "MAC-DV, WIN-DV and GAME input modes"
    depends on PROSPECTOR_TOUCH_UI && ZMK_SPLIT_ROLE_CENTRAL && ZMK_POINTING
    default n
    help
      Requires the dedicated touch_modes keymap (base layers 0,1,2).

config PROSPECTOR_RELEASE_TAG
    string "Touch firmware release label"
    default "DEV"
    depends on PROSPECTOR_TOUCH_UI

config PROSPECTOR_KEYMAP_LABEL
    string "Built keymap label shown on device page"
    default "QWERTY"
    depends on PROSPECTOR_TOUCH_UI

choice PROSPECTOR_STATUS_SCREEN_LAYOUT
    prompt "Status screen layout"
    default PROSPECTOR_STATUS_SCREEN_CLASSIC

config PROSPECTOR_STATUS_SCREEN_CLASSIC
    bool "Classic layout"
    help
        Standard Prospector status screen

config PROSPECTOR_STATUS_SCREEN_RADII
    bool "Radii layout"
    help
        Colorful grid layout with rounded widgets

config PROSPECTOR_STATUS_SCREEN_FIELD
    bool "Field layout"
    help
        Minimal layout with flowing typing activity visualization

config PROSPECTOR_STATUS_SCREEN_OPERATOR
    bool "Operator layout"
    help
        Technical and information dense layout

endchoice

config PROSPECTOR_ROTATE_DISPLAY_180
    bool "Rotate the display 180 degrees"
    default n

config PROSPECTOR_SHOW_MODIFIERS
    bool "Display modifier key indicators (Cmd, Opt, Ctrl, Shift)"
    default y

config PROSPECTOR_SHOW_INACTIVE_MODIFIERS
    bool "Show inactive modifier indicators (dim when not pressed)"
    default y
    depends on PROSPECTOR_SHOW_MODIFIERS
    help
      When enabled, inactive modifiers are shown with a dim color.
      When disabled, inactive modifiers are hidden completely.
      Only affects classic and field layouts.

config PROSPECTOR_MODIFIER_ORDER
    string "Modifier display order"
    default "GACS"
    depends on PROSPECTOR_SHOW_MODIFIERS
    help
      Order of modifier indicators. Use exactly 4 characters:
      G=GUI/Cmd, A=Alt/Opt, C=Control, S=Shift.
      Each character must appear exactly once.

choice PROSPECTOR_MODIFIER_OS
    prompt "Modifier key style"
    default PROSPECTOR_MODIFIER_OS_MAC
    depends on PROSPECTOR_SHOW_MODIFIERS

config PROSPECTOR_MODIFIER_OS_GENERIC
    bool "Generic (CTRL, ALT, GUI, SHFT)"

config PROSPECTOR_MODIFIER_OS_WINDOWS
    bool "Windows"

config PROSPECTOR_MODIFIER_OS_MAC
    bool "Mac"

endchoice

config PROSPECTOR_USE_AMBIENT_LIGHT_SENSOR
    bool "Use ambient light sensor for auto brightness"
    default y

rsource "drivers/sensor/apds9960/Kconfig"

config PROSPECTOR_FIXED_BRIGHTNESS
    int "Fixed display brightness"
    default 50
    range 1 100
    depends on !PROSPECTOR_USE_AMBIENT_LIGHT_SENSOR

config PROSPECTOR_BRIGHTNESS_STEP
    int "Display brightness step"
    default 10
    range 1 100
    help
      Percentage-point step used by Prospector display brightness key bindings.

config PROSPECTOR_LAYER_NAME_UPPERCASE
    bool "Display layer names in uppercase"
    default y
    help
      When enabled, layer names will be converted to uppercase for display.

config PROSPECTOR_TOUCH_UI
    bool "Enable Prospector touch settings UI"
    default n
    depends on SHIELD_PROSPECTOR_ADAPTER
    help
      Enables on-screen brightness slider with Zephyr LVGL touch input.
```

## dts/bindings/behaviors/zmk,behavior-prospector-input-mode.yaml
```yaml
description: Request a Prospector base input mode after keys are released
compatible: "zmk,behavior-prospector-input-mode"
include: one_param.yaml
```

## dts/bindings/behaviors/zmk,behavior-prospector-shortcut.yaml
```yaml
description: Mode aware editing shortcut (copy paste cut undo redo select all)
compatible: "zmk,behavior-prospector-shortcut"
include: one_param.yaml
```
